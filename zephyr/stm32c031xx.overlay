#include <zephyr/dt-bindings/gpio/gpio.h>
#include <zephyr/dt-bindings/led/led.h>

/ {
    ws2812: ws2812 {
        compatible = "worldsemi,ws2812-gpio";
        chain-length = <12>;
        color-mapping = <LED_COLOR_ID_GREEN
                        LED_COLOR_ID_RED
                        LED_COLOR_ID_BLUE>;
        gpios = <&gpiob 1 0>;
    };

	aliases {
		led-strip = &ws2812;
	};
};

